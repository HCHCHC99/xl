/*=============================================================================
 * foc_control.c  —  L5 控制层实现（20 kHz EOCA 中断宿主）
 *=============================================================================*/

#include "foc_control.h"
#include "motor_sampling.h"
#include "hw_encoder.h"
#include "hc32_ll.h"
#include "hc32_ll_adc.h"
#include "timer6_timebase.h"
#include "rtt_log.h"
#include "foc_protect.h"

#include "foc_mode.h"
#include "clarke_park.h"
#include "svpwm.h"
#include "hw_tmr4_pwm.h"
#include "cfg_sampling.h"
#include "encoder_calib.h"
#include "hw_board_pins.h"

/*---------------------------------------------------------------------------
 * 节拍测量用的常量
 *---------------------------------------------------------------------------*/
#define FC_DT_SANE_MIN_US   10u
#define FC_DT_SANE_MAX_US   200u

/* ISR 节拍 = 20 kHz */
#define FC_ISR_TS_S         (1.0f / 20000.0f)

/* 哨兵：标记上一拍走了 enable=true 分支 */
#define FC_LAST_MODE_IN_IF  ((foc_mode_t)0xFE)

/*=============================================================================
 * Keil Watch 观测量
 *=============================================================================*/
volatile uint32_t g_dbg_cnt_at_isr    = 0;
volatile uint32_t g_fc_isr_cnt        = 0;
volatile uint32_t g_fc_isr_dt_max_us  = 0;
volatile uint32_t g_fc_isr_dt_min_us  = 0xFFFFFFFFu;
volatile uint32_t g_fc_isr_dt_last_us = 0;

volatile int32_t  g_fc_enc_count      = 0;
volatile int32_t  g_fc_enc_delta      = 0;
volatile float    g_fc_enc_mech_deg   = 0.0f;
volatile float    g_fc_enc_elec_deg   = 0.0f;
volatile float    g_fc_enc_speed_rpm  = 0.0f;

volatile float    g_fc_i_total        = 0.0f;
volatile float    g_fc_iu             = 0.0f;
volatile float    g_fc_iv             = 0.0f;
volatile float    g_fc_iw             = 0.0f;
volatile float    g_fc_vbus           = 0.0f;

volatile float    g_fc_id             = 0.0f;
volatile float    g_fc_iq             = 0.0f;

volatile uint32_t g_fc_sample_seq     = 0;

/* Mode 3 对齐期间标志 */
volatile uint8_t  g_align_active      = 0u;

/*---------------------------------------------------------------------------
 * 内部状态
 *---------------------------------------------------------------------------*/
static volatile uint8_t  s_enabled     = 0;
static volatile uint16_t s_prev_ts_cnt = 0;
static volatile uint8_t  s_ts_init     = 0;
static volatile int32_t  s_prev_enc    = 0;
static uint32_t          s_ticks_per_us = 1u;

static foc_mode_t        s_last_static_mode = (foc_mode_t)0xFF;
static uint8_t           s_if_resumed = 0u;

/*=============================================================================
 * 节拍采样
 *=============================================================================*/
static void Foc_Control_MeasureDt(void)
{
    uint16_t cnt = (uint16_t)Timer6_Timebase_GetCounter();
    uint16_t d;

    if (!s_ts_init) {
        s_prev_ts_cnt = cnt;
        s_ts_init = 1u;
        return;
    }

    d = (uint16_t)(cnt - s_prev_ts_cnt);
    s_prev_ts_cnt = cnt;

    {
        uint32_t us = (uint32_t)d / s_ticks_per_us;

        if ((us >= FC_DT_SANE_MIN_US) && (us <= FC_DT_SANE_MAX_US)) {
            g_fc_isr_dt_last_us = us;
            if (us > g_fc_isr_dt_max_us) g_fc_isr_dt_max_us = us;
            if (us < g_fc_isr_dt_min_us) g_fc_isr_dt_min_us = us;
        }
    }
}

void Foc_Control_Step(void)
{
    MotorSample_t s;
    int32_t enc_now;
    float   mech;
    float   theta_e;
    float   ialpha, ibeta;

    g_fc_isr_cnt++;

    Foc_Control_MeasureDt();

    /* ---- 1. 编码器（对齐期间也要更新，保证 DoAlignBlocking 读到最新计数）---- */
    hw_encoder_update_count_from_isr();

    enc_now = hw_encoder_get_count();
    g_fc_enc_delta = enc_now - s_prev_enc;
    s_prev_enc     = enc_now;
    g_fc_enc_count = enc_now;

    mech = hw_encoder_get_mech_angle_rad();
    g_fc_enc_mech_deg = mech * 57.29578f;

    /* 电角度：IDLE/对齐期间也持续更新，保证 g_fc_enc_elec_deg 实时跟踪 */
    theta_e = hw_encoder_get_elec_angle_rad(FOC_CONTROL_POLE_PAIRS);
    g_fc_enc_elec_deg = theta_e * 57.29578f;

    /* ---- 2. 电流采样 ---- */
    Motor_GetSample(&s);
    g_fc_i_total = s.i_total;
    g_fc_iu      = s.iu;
    g_fc_iv      = s.iv;
    g_fc_iw      = s.iw;
    g_fc_vbus    = s.vbus;
    g_fc_sample_seq = s.seq;

    /* ---- 2b. 过流保护搬运 ---- */
    Foc_Protect_PushIsr(g_fc_iu, g_fc_iv, g_fc_iw);

    /* ---- 3. Clarke & Park ---- */
    Clarke(g_fc_iu, g_fc_iv, g_fc_iw, &ialpha, &ibeta);
    Park(ialpha, ibeta, theta_e, (float *)&g_fc_id, (float *)&g_fc_iq);

    /* ---- 3b. Mode 3 对齐期间：ISR 不碰 PWM ----
     *   编码器/电流/角度已更新完（第 1~3 步），
     *   这里 return，跳过 Foc_Mode_Step + set_duty3，
     *   让主循环 DoAlignBlocking 的 set_duty3 生效 */
    if (g_align_active) {
        EncoderCalib_Task20k();   /* ZERO 阶段零偏采样，非 ZERO 直接 return */
        return;
    }

    /* ---- 4. 控制链 ---- */
    {
        FocCmd_t  cmd;
        float     valpha, vbeta;
        SvpwmCtx_t ctx;

        Foc_Mode_Step(FC_ISR_TS_S, &cmd);

        if (cmd.enable) {
            if (!s_if_resumed) {
                s_if_resumed = 1u;
                hw_tmr4_pwm_resume_output();
            }

            s_last_static_mode = FC_LAST_MODE_IN_IF;

            InvPark(cmd.vd, cmd.vq, cmd.theta_e, &valpha, &vbeta);

            ctx.valpha = valpha;
            ctx.vbeta  = vbeta;
            ctx.vbus   = CFG_SAMPLING_SIM_VBUS_V;
            SVPWM_Calc(&ctx);

            hw_tmr4_pwm_set_duty3(ctx.duty_u * 100.0f,
                                  ctx.duty_v * 100.0f,
                                  ctx.duty_w * 100.0f);
        } else {
            s_if_resumed = 0u;

            if (s_last_static_mode != g_fm_mode) {
                s_last_static_mode = g_fm_mode;

                if (g_fm_mode == FOC_MODE_IDLE) {
                    hw_tmr4_pwm_set_all_low();
                } else {
                    hw_tmr4_pwm_resume_output();
                    hw_tmr4_pwm_set_duty3(50.0f, 50.0f, 50.0f);
                }
            }
        }
    }
}

static void Foc_Control_EocaHandler(void)
{
		//GPIO_TogglePins(HW_PIN_DEBUG_TOGGLE_PORT , HW_PIN_DEBUG_TOGGLE_PIN);
    g_dbg_cnt_at_isr = TMR4_GetCountValue(CM_TMR4_3);
    Motor_Sampling_EocaCallback();
    Foc_Control_Step();
}

void Foc_Control_Init(void)
{
    stc_irq_signin_config_t stcIrq;
    uint32_t freq;

    freq = Timer6_Timebase_GetFrequency();
    if (freq < 1000000u) freq = 1000000u;
    s_ticks_per_us = freq / 1000000u;
    if (s_ticks_per_us == 0u) s_ticks_per_us = 1u;

    Foc_Control_ResetStats();

    stcIrq.enIntSrc    = INT_SRC_ADC1_EOCA;
    stcIrq.enIRQn      = INT116_IRQn;
    stcIrq.pfnCallback = &Foc_Control_EocaHandler;
    if (LL_OK != INTC_IrqSignIn(&stcIrq)) {
        MAIN_E("[FC] INTC_IrqSignIn failed for EOCA");
        return;
    }

    NVIC_ClearPendingIRQ(INT116_IRQn);
    NVIC_SetPriority(INT116_IRQn, FOC_CONTROL_IRQ_PRIO);

    ADC_IntCmd(CM_ADC1, ADC_INT_EOCA, ENABLE);

    s_enabled = 1u;
    NVIC_EnableIRQ(INT116_IRQn);

    MAIN_D("[FC] EOCA 20kHz control layer ready: prio=%u, ticks/us=%lu",
           (unsigned)FOC_CONTROL_IRQ_PRIO, (unsigned long)s_ticks_per_us);
}

void Foc_Control_Enable(void)
{
    if (!s_enabled) {
        s_enabled = 1u;
        NVIC_EnableIRQ(INT116_IRQn);
    }
}

void Foc_Control_Disable(void)
{
    s_enabled = 0u;
    NVIC_DisableIRQ(INT116_IRQn);
}

uint8_t Foc_Control_IsEnabled(void)
{
    return s_enabled;
}

void Foc_Control_ResetStats(void)
{
    NVIC_DisableIRQ(INT116_IRQn);

    g_fc_isr_cnt        = 0;
    g_fc_isr_dt_max_us  = 0;
    g_fc_isr_dt_min_us  = 0xFFFFFFFFu;
    g_fc_isr_dt_last_us = 0;
    g_fc_sample_seq     = 0;

    s_ts_init      = 0u;
    s_prev_ts_cnt  = 0u;
    s_prev_enc     = hw_encoder_get_count();
    s_last_static_mode = (foc_mode_t)0xFF;
    s_if_resumed   = 0u;

    if (s_enabled) {
        NVIC_EnableIRQ(INT116_IRQn);
    }
}

/*******************************************************************************
 * EOF
 ******************************************************************************/
